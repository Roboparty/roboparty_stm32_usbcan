## boards/roboto_usb2can/Kconfig.roboto_usb2can
```kconfig
# Copyright (c) 2024 Sean Nyekjaer <sean@geanix.com>
# SPDX-License-Identifier: GPL-3.0-only

config BOARD_ROBOTO_USB2CAN
	select SOC_STM32G431XX
```

## boards/roboto_usb2can/board.yml
```yaml
# Copyright (c) 2025 roboparty <2321901849@qq.com>
# SPDX-License-Identifier: GPL-3.0-only

board:
  name: roboto_usb2can
  full_name: roboto_usb2can
  vendor: roboparty
  socs:
    - name: stm32g431xx
      variants:
        - name: 'roboto_usb2can'
```
